#include "LCDIcons.h"

#include <string.h>

#include "I2C_bus_shared.h"
namespace LCDIcons {

namespace {

constexpr uint32_t kLcdI2cLockTimeoutMs = 1;
constexpr uint8_t kInvalidPaletteId = 0xFF;

constexpr uint8_t kGlyphs[][8] = {
  {0x00,0x0E,0x15,0x17,0x11,0x0E,0x00,0x00}, // Alarm
  {0x00,0x0A,0x1F,0x1F,0x0E,0x04,0x00,0x00}, // Heart
  {0x04,0x0E,0x0E,0x0E,0x1F,0x00,0x04,0x00}, // Bell
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  {0x00,0x0E,0x11,0x15,0x13,0x0E,0x00,0x00}, // Clock2
};

constexpr uint8_t glyphCount() {
  return (uint8_t)(sizeof(kGlyphs) / sizeof(kGlyphs[0]));
}

constexpr IconId kHomePalette[] = {
  IconId::Ntp,
  IconId::Bell,
  IconId::Heart,
  IconId::Check,
  IconId::Cross,
  IconId::Smile,
  IconId::Sad,
  IconId::Note,
};

constexpr IconId kHomeWifiPalette[] = {
  IconId::Ntp,
  IconId::Bell,
  IconId::Heart,
  IconId::Check,
  IconId::Cross,
  IconId::Smile,
  IconId::Sad,
  IconId::Wifi,
};

constexpr IconId kWeatherPalette[] = {
  IconId::Cloud,
  IconId::Rain,
  IconId::Snow,
  IconId::Wind,
  IconId::Pressure,
  IconId::Snowflake,
  IconId::Umbrella,
  IconId::Flame,
};

constexpr IconId kSystemPalette[] = {
  IconId::BatteryFull,
  IconId::BatteryMed,
  IconId::BatteryLow,
  IconId::BatteryEmpty,
  IconId::Lock,
  IconId::Unlock,
  IconId::Speaker,
  IconId::Mute,
};

constexpr IconId kMediaPalette[] = {
  IconId::Settings,
  IconId::Person,
  IconId::Plug,
  IconId::Signal,
  IconId::Antenna,
  IconId::Target,
  IconId::Power,
  IconId::Menu3,
};

uint8_t s_loadedIconBySlot[kCgramSlots] = {
  0xFF, 0xFF, 0xFF, 0xFF,
  0xFF, 0xFF, 0xFF, 0xFF,
};

uint8_t s_lastLoadedPaletteId = kInvalidPaletteId;

bool loadIconUnlocked(LiquidCrystal_I2C& lcd, uint8_t slot, IconId iconId) {
  const uint8_t id = static_cast<uint8_t>(iconId);
  if (slot >= kCgramSlots || id >= glyphCount()) {
    return false;
  }

  if (s_loadedIconBySlot[slot] == id) {
    return false;
  }

  uint8_t glyph[8];
  memcpy(glyph, kGlyphs[id], sizeof(glyph));
  lcd.createChar(slot, glyph);
  s_loadedIconBySlot[slot] = id;
  return true;
}

void loadIconsUnlocked(LiquidCrystal_I2C& lcd, const IconId* iconIds, uint8_t count, uint8_t firstSlot) {
  if (iconIds == nullptr) {
    return;
  }

  for (uint8_t i = 0; i < count; ++i) {
    const uint8_t slot = (uint8_t)(firstSlot + i);
    if (slot >= kCgramSlots) {
      break;
    }
    loadIconUnlocked(lcd, slot, iconIds[i]);
  }
}

}  // namespace

void resetPaletteCache() {
  s_lastLoadedPaletteId = kInvalidPaletteId;
  for (uint8_t i = 0; i < kCgramSlots; ++i) {
    s_loadedIconBySlot[i] = 0xFF;
  }
}

void loadIcon(LiquidCrystal_I2C& lcd, uint8_t slot, IconId iconId) {
  if (!I2cShared::lock(kLcdI2cLockTimeoutMs)) {
    return;
  }

  loadIconUnlocked(lcd, slot, iconId);
  I2cShared::unlock();
}

void loadIcons(LiquidCrystal_I2C& lcd, const IconId* iconIds, uint8_t count, uint8_t firstSlot) {
  if (iconIds == nullptr) {
    return;
  }

  if (!I2cShared::lock(kLcdI2cLockTimeoutMs)) {
    return;
  }

  loadIconsUnlocked(lcd, iconIds, count, firstSlot);
  I2cShared::unlock();
}

void loadPalette(LiquidCrystal_I2C& lcd, Palette palette) {
  const uint8_t paletteId = static_cast<uint8_t>(palette);
  if (paletteId == s_lastLoadedPaletteId) {
    return;
  }

  const IconId* iconIds = nullptr;
  uint8_t count = 0;

  switch (palette) {
    case Palette::Home:
      iconIds = kHomePalette;
      count = (uint8_t)(sizeof(kHomePalette) / sizeof(kHomePalette[0]));
      break;
    case Palette::HomeWifi:
      iconIds = kHomeWifiPalette;
      count = (uint8_t)(sizeof(kHomeWifiPalette) / sizeof(kHomeWifiPalette[0]));
      break;
    case Palette::Weather:
      iconIds = kWeatherPalette;
      count = (uint8_t)(sizeof(kWeatherPalette) / sizeof(kWeatherPalette[0]));
      break;
    case Palette::System:
      iconIds = kSystemPalette;
      count = (uint8_t)(sizeof(kSystemPalette) / sizeof(kSystemPalette[0]));
      break;
    case Palette::Media:
      iconIds = kMediaPalette;
      count = (uint8_t)(sizeof(kMediaPalette) / sizeof(kMediaPalette[0]));
      break;
  }

  if (iconIds == nullptr || count == 0) {
    return;
  }

  if (!I2cShared::lock(kLcdI2cLockTimeoutMs)) {
    return;
  }

  loadIconsUnlocked(lcd, iconIds, count, 0);
  s_lastLoadedPaletteId = paletteId;
  I2cShared::unlock();
}

}  // namespace LCDIcons